#include "Flash.h"
#include "GPIO_Interface.h"
#include "V94XX_FLASH.h"  

#include "basic_srv.h"
#include <string.h>

#define bool int 
// Your binary data
 uint8_t module_data[] = {
    0x4d, 0x4d, 0x4d, 0x4d, 0xf1, 0x0a, 0x00, 0x00, 0x9e, 0x7c, 0x08, 0x00, 0x25, 0x06, 0x00, 0x00,
    0x5f, 0x06, 0x00, 0x00, 0x8b, 0x06, 0x00, 0x00, 0x95, 0x06, 0x00, 0x00, 0x09, 0x07, 0x00, 0x00,
    0x2b, 0x07, 0x00, 0x00, 0x67, 0x07, 0x00, 0x00, 0x81, 0x07, 0x00, 0x00, 0x40, 0x10, 0x00, 0x20,
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    0x61, 0x68, 0x09, 0x68, 0x88, 0x47, 0x35, 0xe0, 0x20, 0x68, 0x00, 0x69, 0x40, 0x06, 0xfb, 0xd5,
    /* ... (continuing all the way to the end) ... */
    0x00, 0xbf, 0x00, 0xbf, 0x02, 0x4a, 0x11, 0x00, 0x18, 0x20, 0xab, 0xbe, 0xfb, 0xe7, 0x26, 0x00,
    0x02, 0x00, 0x25, 0x06, 0x00, 0x00, 0x5f, 0x06, 0x00, 0x00, 0x09, 0x07, 0x00, 0x00, 0x2b, 0x07,
    0x00, 0x00, 0x8b, 0x06, 0x00, 0x00, 0x67, 0x07, 0x00, 0x00, 0x81, 0x07, 0x00, 0x00, 0x31, 0x32,
    0x33, 0x41, 0x34, 0x35, 0x36, 0x42, 0x37, 0x38, 0x39, 0x43, 0x2a, 0x30, 0x23, 0x44, 0x00, 0x20,
    0x01, 0x40, 0x00, 0x00, 0x00, 0x20, 0x14, 0x00, 0x00, 0x20, 0x00, 0xbf, 0x00, 0xbf, 0x00, 0xbf,
    0x00, 0xbf, 0xff, 0xf7, 0xb6, 0xff, 0x00, 0x48, 0x00, 0x47, 0xd5, 0x0a, 0x00, 0x00, 0x4d, 0x4d,
    0x4d, 0x4d, 0xc8, 0x00, 0x01, 0xff, 0x00

};
 uint32_t MODULE_SIZE = sizeof(module_data);
     uint8_t read_buf[2845]={0};


bool program_module_from_buffer(uint8_t* buffer, uint32_t size, uint32_t flash_addr)
{
    if (buffer == 0 || size == 0)
        return false;

    // 1. Erase required sectors (4KB each)
    uint32_t sectors = (size + 4095) / 4096;

    for (uint32_t i = 0; i < sectors; i++)
    {
        uint32_t addr = flash_addr + (i * 4096);

        uint8_t addr_bytes[3] = {
            (uint8_t)(addr >> 16),
            (uint8_t)(addr >> 8),
            (uint8_t)addr
        };

        FLASH_gSectorErase(addr_bytes);
    }

    // 2. Program 256-byte pages
    for (uint32_t offset = 0; offset < size; offset += 256)
    {
        uint32_t page_size = (size - offset > 256) ? 256 : (size - offset);
        uint32_t addr = flash_addr + offset;

        

        FlashWrite(addr, &buffer[offset], page_size);
        // FlashWrite((uint32_t)0x000000, module_data, 256);

            Delay_ms(100);
        FlashRead(addr, &read_buf[offset], page_size);


            

    }

    return true;
}

// Usage:
uint32_t flash_addr = 0x000000;
#define  FLASH_FM25W32_ENABLE
int main(void)
{  
    uint32_t i;
    uint16_t chunk;
    uint8_t status;
   // Initialize system
    S_CLK_Init(1);
    vMC_DriversInit();
    S_GpioInit_ALL_Modules();
    FLASH_gInit();
    Delay_ms(100);
    S_SPI1_INIT();
    
   //program_module_from_buffer(module_data,MODULE_SIZE, 0x000000);   // Module 0 at 0x000000
    Flash_erase_sector_by_address(0x000000);
    Delay_ms(100);

    for (uint32_t offset = 0; offset < MODULE_SIZE; offset += 256)
    {
        uint32_t addr = flash_addr + offset;
        
    FlashWrite((uint32_t)addr, &module_data[offset], 256);
    Delay_ms(100);
   FlashRead((uint32_t)addr , &read_buf[offset] , 256);

    Delay_ms(100);
    
    }
    /**
    FlashWrite((uint32_t)0x000100, &module_data[256], 256);
    Delay_ms(100);
   FlashRead((uint32_t)0x000100 , &read_buf[256], 256);**/

    Delay_ms(100);

    
    
Keypad_Init();  
   while(1) {
        Delay_ms(1000);
    }
    
    return 0;
}

